/dts-v1/;
/plugin/;

/ {
    fragment@0 {
        target = <&amba_pl>;
        __overlay__ {
            monitor_0: monitor@fpga {
                compatible = "cei.upm,monitor-1.00.a";
                reg = <0x7ab00000 0x10000 0xb0100000 0x40000 0xb0180000 0x20000>;
                reg-names = "ctrl", "power", "traces";
                interrupt-parent = <&intc>;
                interrupts = <0 29 1>;
                interrupt-names = "irq";
                dmas = <&dmac_s 1>;
                dma-names = "ps-dma-mon";
            };
        };
    };
};
