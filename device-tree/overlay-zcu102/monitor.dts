/dts-v1/;
/plugin/;

/ {
    fragment@0 {
        target = <&amba_pl>;
        __overlay__ {
            monitor_0: monitor@fpga {
                compatible = "cei.upm,monitor-1.00.a";
                reg = <0x0 0xa0100000 0x0 0x10000 0x0 0xb0100000 0x0 0x80000 0x0 0xb0180000 0x0 0x20000>;
                reg-names = "ctrl", "power", "traces";
                interrupt-parent = <&gic>;
                interrupts = <0 90 1>;
                interrupt-names = "irq";
                dmas = <&fpd_dma_chan2 0>;
                dma-names = "ps-dma-mon";
            };
        };
    };
    fragment@1 {
        target = <&fpd_dma_chan2>;
        __overlay__ {
            #dma-cells = <1>;
            status = "okay";
        };
    };
};
