/*
 * Monitor device tree overlay
 *
 * Author : Juan Encinas <juan.encinas@upm.es>
 * Date   : October 2021
 *
 * "Plug & Play" attachment of the Monitor memory maps into the static
 * device tree of the system.
 *
 */

<a3<artico3_preproc>a3>

/dts-v1/;
/plugin/;

<a3<if DEVICE=="zynq">a3>
/ {
    fragment@0 {
        target = <&amba_pl>;
        __overlay__ {
            monitor_0: monitor@fpga {
                compatible = "cei.upm,monitor-1.00.a";
                reg = <0x7ab00000 0x10000 0xb0100000 0x40000 0xb0180000 0x20000>;
                reg-names = "ctrl", "power", "traces";
                interrupt-parent = <&intc>;
                interrupts = <0 30 1>;
                interrupt-names = "irq";
                dmas = <&dmac_s 1>;
                dma-names = "ps-dma-mon";
            };
        };
    };
};
<a3<end if>a3>
<a3<if DEVICE=="zynqmp">a3>
/ {
    fragment@0 {
        target = <&amba_pl>;
        __overlay__ {
            monitor_0: monitor@fpga {
                compatible = "cei.upm,monitor-1.00.a";
                reg = <0x0 0xa0100000 0x0 0x10000 0x0 0xb0100000 0x0 0x80000 0x0 0xb0180000 0x0 0x20000>;
                reg-names = "ctrl", "power", "traces";
                interrupt-parent = <&gic>;
                interrupts = <0 90 1>;
                interrupt-names = "irq";
                dmas = <&fpd_dma_chan2 0>;
                dma-names = "ps-dma-mon";
            };
        };
    };
    fragment@1 {
        target = <&fpd_dma_chan2>;
        __overlay__ {
            #dma-cells = <1>;
            status = "okay";
        };
    };
};
<a3<end if>a3>
